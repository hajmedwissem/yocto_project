## meta-wissem-bsp/conf/machine/myboard.conf
```bitbake
require conf/machine/qemuarm64.conf


PREFERRED_PROVIDER_virtual/kernel = "linux-yocto"
PREFERRED_VERSION_linux-yocto = "6.12%"


MACHINEOVERRIDES =. "myboard:"


MACHINE_FEATURES = ""

KERNEL_IMAGETYPE = "zImage"

PREFERRED_PROVIDER_virtual/bootloader ?= "u-boot"
UBOOT_MACHINE ?= "qemu_arm64_defconfig"
```

## meta-wissem-distro/conf/distro/techleef.conf
```bitbake
DISTRO = "techleef"
DISTRO_NAME = "techleef distro"
DISTROOVERRIDES = "techleef"


TCLIBC = "musl"

INIT_MANAGER ?= "systemd"

VIRTUAL-RUNTIME_base-utils = "busybox"
```
